## buildroot/configs/syno_defconfig
```kconfig
#
# Target options
#
BR2_x86_64=y

#
# Mirrors and Download locations
#
# BR2_STATIC_LIBS is not set
BR2_SHARED_LIBS=y

#
# Toolchain
#
BR2_TOOLCHAIN_BUILDROOT_GLIBC=y
BR2_TOOLCHAIN_BUILDROOT_CXX=y

#
# Toolchain Generic Options
#
BR2_USE_WCHAR=y

#
# System configuration
#
BR2_TARGET_GENERIC_HOSTNAME="syno"
BR2_TARGET_GENERIC_ISSUE="Welcome to Redpill"

BR2_SYSTEM_BIN_SH_BASH=y
BR2_SYSTEM_BIN_SH="bash"

BR2_ROOTFS_OVERLAY="board/syno/rootfs-overlay"
BR2_ROOTFS_DEVICE_CREATION_DYNAMIC_EUDEV=y

#
# Kernel
#
BR2_LINUX_KERNEL=y
BR2_LINUX_KERNEL_DEFCONFIG="x86_64"
BR2_LINUX_KERNEL_XZ=y

#
# Target packages
#
BR2_PACKAGE_BUSYBOX_CONFIG="board/syno/busybox_defconfig"
BR2_PACKAGE_BUSYBOX_SHOW_OTHERS=y
BR2_PACKAGE_XZ=y
BR2_PACKAGE_CPIO=y
BR2_PACKAGE_KEXEC=y
BR2_PACKAGE_KEXEC_ZLIB=y
BR2_PACKAGE_DTC=y
BR2_PACKAGE_DTC_PROGRAMS=y
BR2_PACKAGE_TTYD=y
BR2_PACKAGE_QUICKJS=y
BR2_PACKAGE_EUDEV=y

#
# Development tools
#
BR2_PACKAGE_BINUTILS=y
BR2_PACKAGE_BINUTILS_TARGET=y

#
# Filesystem images
#

BR2_TARGET_ROOTFS_CPIO=y
BR2_TARGET_ROOTFS_CPIO_XZ=y
BR2_TARGET_ROOTFS_INITRAMFS=y
```
